// SPDX-License-Identifier: GPL-2.0-only

/dts-v1/;

/include/ "msm8953.dtsi"

/ {
	// This is used by the bootloader to find the correct DTB
	qcom,msm-id = <293 0x0>;
	qcom,board-id = <0x1000b 1>;

	model = "Xiaomi Redmi 4 Prime (markw)";
	compatible = "qcom,msm8953-markw", "qcom,msm8953-xiaomi", "xiaomi,markw", "qcom,msm8953", "lk2nd,device";
	lk2nd,pstore = <0x9ff00000 0x00100000>;
};
