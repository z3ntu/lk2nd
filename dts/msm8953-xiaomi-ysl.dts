// SPDX-License-Identifier: GPL-2.0-only

/dts-v1/;

/include/ "msm8953.dtsi"

/ {
	// This is used by the bootloader to find the correct DTB
	qcom,msm-id = <293 0>;
	qcom,board-id = <8 0>;

	model = "Xiaomi Redmi S2/Y2 (ysl)";
	compatible = "xiaomi,ysl", "qcom,msm8953", "lk2nd,device";
	lk2nd,pstore = <0x9ff00000 0x00100000>;
};
