// SPDX-License-Identifier: BSD-3-Clause

#include <skeleton64.dtsi>
#include <lk2nd.dtsi>

/ {
	qcom,msm-id = <QCOM_ID_SDM632 0x00>;
	qcom,pmic-id = <0x10016 0x25 0x00 0x00>;
	qcom,board-id = <8 3>;

	// Empty nodes so the bootloader is happy
	__symbols__ {};
	chosen {};
	memory {};
};

&lk2nd {
	model = "Fairphone 3";
	compatible = "fairphone,fp3";
};
